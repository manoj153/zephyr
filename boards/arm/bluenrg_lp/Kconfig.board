## boards/arm/bluenrg_lp/Kconfig.board
```kconfig
# STMicroelectronics B-L072Z-LRWAN1 Discovery board configuration

# Copyright (c) 2018 Aleksandr Makarov <aleksandr.o.makarov@gmail.com>
# SPDX-License-Identifier: Apache-2.0

config BOARD_BLUENRG_LP
	bool "STMicroelectronics B-L072Z-LRWAN1 Discovery kit"
	depends on SOC_ST_BLUENRG_LP_3X5XX
```

## boards/arm/bluenrg_lp/Kconfig.defconfig
```kconfig
# STMicroelectronics B-L072Z-LRWAN1 Discovery board configuration

# Copyright (c) 2018 Aleksandr Makarov <aleksandr.o.makarov@gmail.com>
# SPDX-License-Identifier: Apache-2.0

if BOARD_BLUENRG_LP

config BOARD
	default "bluenrg_lp"

endif # BOARD_B_L072Z_LRWAN1
```

## boards/arm/bluenrg_lp/bluenrg_lpx_defconfig
```kconfig
# SPDX-License-Identifier: Apache-2.0

# Zephyr Kernel Configuration
CONFIG_SOC_SERIES_ST_BLUENRG_LP=y

# Platform Configuration
CONFIG_SOC_ST_BLUENRG_LP_3X5XX=y
CONFIG_BOARD_BLUENRG_LP =y

# Enable MPU
CONFIG_ARM_MPU=y
```

## boards/arm/gd32_ucmodule/Kconfig.board
```kconfig
# Copyright (c) 2021, ATL Electronics
# SPDX-License-Identifier: Apache-2.0

config BOARD_GD32_UC_MODULE
	bool "GigaDevice GD32F303 UC-Module"
	depends on SOC_GD32F303
```

## boards/arm/gd32_ucmodule/Kconfig.defconfig
```kconfig
# Copyright (c) 2021 ATL Electronics
# SPDX-License-Identifier: Apache-2.0

if BOARD_GD32_UC_MODULE

config BOARD
	default "gd32_uc_module"

endif   # BOARD_GD32_UC_MODULE
```

## boards/arm/gd32_ucmodule/gd32_ucmodule_defconfig
```kconfig
CONFIG_SOC_SERIES_GD32F30X=y
CONFIG_SOC_GD32F303=y
CONFIG_BOARD_GD32_UC_MODULE=y

CONFIG_ARM_MPU=y
CONFIG_HW_STACK_PROTECTION=y

CONFIG_CONSOLE=y
CONFIG_UART_CONSOLE=y
CONFIG_SERIAL=y

CONFIG_GPIO=y
```

## soc/arm/gigadevice/gd32f30x/Kconfig.defconfig.gd32f303
```kconfig
config SOC
	default "gd32f30x_hd"

config SYS_CLOCK_HW_CYCLES_PER_SEC
	default $(dt_node_int_prop_int,/cpus/cpu@0,clock-frequency)

config NUM_IRQS
	default 67
```

## soc/arm/gigadevice/gd32f30x/Kconfig.defconfig.series
```kconfig
if SOC_SERIES_GD32F30X

source "soc/arm/gigadevice/gd32f30x/Kconfig.defconfig.gd32*"

config SOC_SERIES
	default "gd32f30x"

endif # SOC_SERIES_GD32F30X
```

## soc/arm/gigadevice/gd32f30x/Kconfig.series
```kconfig
config SOC_SERIES_GD32F30X
	bool "GigaDevice GD32F30X series Cortex-M4F MCU"
	select ARM
	select CPU_HAS_ARM_MPU
	select CPU_HAS_FPU
	select CPU_CORTEX_M4
	select CPU_CORTEX_M_HAS_SYSTICK
	select CPU_CORTEX_M_HAS_VTOR
	select SOC_FAMILY_GD32_ARM
	select GD32_HAS_AFIO_PINMUX
	select GD32_HAS_IRC_40K
	help
	  Enable support for GigaDevice GD32F30X MCU series
```

## soc/arm/gigadevice/gd32f30x/Kconfig.soc
```kconfig
choice
	prompt "GigaDevice GD32F30X MCU Selection"
	depends on SOC_SERIES_GD32F30X

	config SOC_GD32F303
		bool "gd32f303"

endchoice
```

## soc/arm/st_bluenrg/Kconfig.defconfig
```kconfig
# SPDX-License-Identifier: Apache-2.0

source "soc/arm/st_bluenrg/*/Kconfig.defconfig.series"
```

## soc/arm/st_bluenrg/st_bluenrg_lp/Kconfig.defconfig.series
```kconfig
# ST Microelectronics bluenrg-lp SoC line

# Copyright (c) 2021 Electrolance Solutions
# SPDX-License-Identifier: Apache-2.0

# Kconfig symbols common to bluenrg-lp series

if SOC_SERIES_BLUENRG_LP

source "soc/arm/st_bluenrg/st_bluenrg_lp/Kconfig.defconfig.st_bluenrg_lp*"

config SOC_SERIES
	default "bluenrg_lp"

endif # SOC_SERIES_BLUENRG_LP
```

## soc/arm/st_bluenrg/st_bluenrg_lp/Kconfig.defconfig.st_bluenrg_lp_3x5xx
```kconfig
# ST Microelectronics STM32L010XX MCU
#
# Copyright (c) 2021 Wouter Cappelle <wouter.cappelle@crodeon.com>
# SPDX-License-Identifier: Apache-2.0

if SOC_ST_BLUENRG_LP_3X5XX

config SOC
	default "ST_BLUENRG_LP_3X5XX"

config NUM_IRQS
	default 32

endif # SOC_ST_BLUENRG_LP_3X5XX
```

## soc/arm/st_bluenrg/st_bluenrg_lp/Kconfig.series
```kconfig
# ST BLUENRG LP SoC series

# Copyright (c) 2021 Electrolance Solutions
# SPDX-License-Identifier: Apache-2.0

config SOC_SERIES_ST_BLUENRG_LP
	bool "ST BlueNRG LP Series SoC"
	select ARM
	select CPU_CORTEX_M0PLUS
	select CPU_CORTEX_M_HAS_VTOR
	select SOC_FAMILY_BLUENRG
	select CPU_CORTEX_M_HAS_SYSTICK
	help
	  Enable support for ST BlueNRG LP MCU series
```

## soc/arm/st_bluenrg/st_bluenrg_lp/Kconfig.soc
```kconfig
# ST Microelectronics bluenrg-lp SoC line

# Copyright (c) 2021 Electrolance Solutions
# SPDX-License-Identifier: Apache-2.0

choice
	prompt "ST BLUENRG LP SoC Selection"
	depends on SOC_SERIES_BLUENRG_LP

config SOC_ST_BLUENRG_LP_3X5XX
	bool "ST_BLUENRG_LP_3X5XX"
	select CPU_HAS_ARM_MPU

endchoice
```
